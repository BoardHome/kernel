// SPDX-License-Identifier: (GPL-2.0+ OR MIT)
/*
 * Copyright (c) 2020 Rockchip Electronics Co., Ltd.
 *
 */

/dts-v1/;

#include "rk3568-firefly-roc-pc-se.dts"
#include "rk3568-amp.dtsi"

/ {
    memory {
        device_type = "memory";
        // 2G DDR reference configuration
        reg = <0x0 0x03880000 0x0 0x04b80000>,
                <0x0 0x0a200000 0x0 0x75e00000>;

        // 4G DDR reference configuration
        //reg = <0x0 0x03880000 0x0 0x04b80000>,
        //        <0x0 0x09400000 0x0 0xe6c00000>,
        //        <0x1 0xf0000000 0x0 0x10000000>;

        // 8G DDR reference configuration
        //reg = <0x0 0x03880000 0x0 0x04b80000>,
        //        <0x0 0x09400000 0x0 0xe6c00000>,
        //        <0x1 0x00000000 0x1 0x00000000>;

    };
};

&arm_pmu {
    interrupt-affinity = <&cpu0>, <&cpu1>, <&cpu2>;
};

/delete-node/ &cpu3;

